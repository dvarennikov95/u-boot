## arch/riscv/dts/nextsilicon-scr7.its
```
/dts-v1/;

/ {
	description = "NextSilicon NextCORE FPGA Linux FIT";
	#address-cells = <2>;

	images {
		kernel {
			description = "Linux Kernel";
			data = /incbin/("/space2/users/ex-alexk/work/linux-6.1.19/arch/riscv/boot/Image");
			type = "kernel";
			arch = "riscv";
			os = "linux";
			compression = "none";
			load = <0x80000000>;
			entry = <0x80000000>;
			hash-1 {
				algo = "crc32";
			};
			hash-2 {
				algo = "sha256";
			};
		};
		fdt {
			description = "u-boot Device Tree";
			data = /incbin/("/space2/users/ex-alexk/work/uboot_daniel/u-boot/arch/riscv/dts/nextsilicon-scr7.dtb");
			type = "flat_dt";
			arch = "riscv";
			compression = "none";
			hash-1 {
				algo = "crc32";
			};
			hash-2 {
				algo = "sha256";
			};
		};
	};

	configurations {
		default = "config";
		config {
			description = "Boot Linux Kernel";
			kernel = "kernel";
                        fdt = "fdt";
		};
	};
};
```

## board/nextsilicon/scr7/Kconfig
```kconfig
if TARGET_NEXTSILICON_SCR7

config SYS_BOARD
    default "scr7"

config SYS_VENDOR
    default "nextsilicon"

config SYS_CPU
	default "generic"

config SYS_CONFIG_NAME
    default "nextsilicon-scr7"

endif
```

## configs/nextsilicon-scr7_defconfig
```kconfig
CONFIG_TARGET_NEXTSILICON_SCR7=y
CONFIG_RISCV=y
CONFIG_ARCH_RV64I=y
CONFIG_RISCV_ISA_F=n
CONFIG_RISCV_ISA_D=n
CONFIG_RISCV_ISA_C=n
CONFIG_CMODEL_MEDANY=y
CONFIG_RISCV_SMODE=y
CONFIG_TEXT_BASE=0xB00000
# CONFIG_SYS_LOAD_ADDR=0xC00000
CONFIG_SYS_LOAD_ADDR=0x1A00000
CONFIG_DEFAULT_DEVICE_TREE="nextsilicon-scr7"
CONFIG_SYS_PROMPT="SCR7# "
CONFIG_IDENT_STRING="SCR7"
CONFIG_CPU=y
CONFIG_CPU_RISCV=y
CONFIG_SBI_V01=y
CONFIG_RISCV_TIMER=y
CONFIG_SERIAL=y
CONFIG_BAUDRATE=115200
CONFIG_DEBUG_UART=y
CONFIG_DEBUG_SBI_CONSOLE=y
CONFIG_SYS_NS16550=y
CONFIG_NR_DRAM_BANKS=1
CONFIG_EFI_LOADER=n
CONFIG_ID_EEPROM=n
CONFIG_PCI_INIT_R=n
CONFIG_DISPLAY_BOARDINFO_LATE=y
CONFIG_BOARD_LATE_INIT=y
CONFIG_CMD_NET=n
CONFIG_AUTOBOOT=y
CONFIG_BOOTDELAY=0
CONFIG_DISABLE_CONSOLE=y
CONFIG_USE_PREBOOT=y
CONFIG_CMD_FS_GENERIC=y
CONFIG_PREBOOT="echo Hello again from Abra! Setting U-boot env variables...;setenv bootdelay 0;bootargs console=ttyUSB2,115200;printenv;bootm 0x1A00000 - 0x2A00000"
CONFIG_VERSION_VARIABLE=y
CONFIG_CMD_BOOTI=y
CONFIG_OF_LIBFDT=y
CONFIG_OF_CONTROL=y
CONFIG_SYS_BOOTM_LEN=0x1000000
CONFIG_DM_DEVICE_REMOVE=n
CONFIG_LOG=y
CONFIG_LOG_MAX_LEVEL=9
```
